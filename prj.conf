## CMakeLists.txt
```
cmake_minimum_required(VERSION 3.20.0)
find_package(Zephyr REQUIRED HINTS $ENV{ZEPHYR_BASE})

project(ono-firmware-v10)

file(GLOB_RECURSE sources src/*.c src/*.h)

#add_executable(app ${sources})

target_include_directories(app PUBLIC src)

add_subdirectory(Fusion/Fusion)
target_link_libraries(app PRIVATE Fusion)

target_link_libraries(Fusion PUBLIC zephyr_interface)

target_sources(app PRIVATE src/main.c src/imu.h src/imu.c src/pmic.h src/pmic.c src/haptics.h src/haptics.c src/pressure.h src/pressure.c src/ble.h src/ble.c)
```

## west.yml
```
manifest:
  self:
    path: application
  remotes:
    - name: nrf
      url-base: https://github.com/nrfconnect
    - name: you
      url-base: https://github.com/CuSither

  projects:
    - name: sdk-nrf
      remote: nrf
      path: nrf
      revision: v3.0.2
      import:
        path-prefix: external
      clone-depth: 1
    - name: zephyr
      remote: you
      repo-path: sdk-zephyr-ono
      revision: fix/spi-rtio-trans-op
      import:
        path-prefix: external
```

## prj.conf
```kconfig
CONFIG_GPIO=y
CONFIG_USE_SEGGER_RTT=y
CONFIG_I2C=y
CONFIG_REGULATOR=y
CONFIG_SENSOR=y
CONFIG_LOG=y
CONFIG_LOG_BACKEND_RTT=y
CONFIG_SPI=y
CONFIG_HAPTICS=y
CONFIG_SENSOR_ASYNC_API=y
CONFIG_ICM42688=y
CONFIG_ICM42688_DECODER=y
CONFIG_ICM42688_STREAM=y
CONFIG_SPI_RTIO=y
CONFIG_RTIO_LOG_LEVEL_DBG=y
CONFIG_EXTRA_EXCEPTION_INFO=y

CONFIG_BT=y
CONFIG_BT_PERIPHERAL=y
CONFIG_BT_DEVICE_NAME="Ono Service"
CONFIG_BT_MAX_CONN=1
CONFIG_BT_EXT_ADV=n
CONFIG_BT_CTLR_TX_PWR_PLUS_8=y
CONFIG_BT_PERIPHERAL_PREF_MAX_INT=6
CONFIG_BT_PERIPHERAL_PREF_MIN_INT=6
CONFIG_BT_USER_PHY_UPDATE=y
CONFIG_BT_CTLR_PHY_2M=y

# CONFIG_BT_HCI_CORE_LOG_LEVEL_DBG=y

CONFIG_MPU_STACK_GUARD=y

# CONFIG_CMSIS_DSP=y
# CONFIG_CMSIS_DSP_STATISTICS=y
# CONFIG_CMSIS_DSP_SUPPORT=y

CONFIG_NEWLIB_LIBC=y
CONFIG_FPU=y
CONFIG_NEWLIB_LIBC_NANO=n

CONFIG_CBPRINTF_FP_SUPPORT=y
```

## src/main.c
```c
#include <imu.h>
#include <pmic.h>
#include <haptics.h>
#include <pressure.h>
#include <ble.h>
#include <zephyr/kernel.h>

void imu_packet_callback(struct sensor_packet* sensor_data) {
    push_packet_to_queue((void*)sensor_data);
}

void callibration_callback(bool containsData, void* buff, uint16_t len) {
    if (!containsData) {
        start_callibration();
    } else {
        feed_callibration_data(buff, len);
    }
}

int main(void) {
    ble_init(callibration_callback);

    pmic_init();
    imu_init(imu_packet_callback);
    k_msleep(1000);
    
    // haptics_init();
    // pressure_init();

    while (1) {
        // haptics_start();
        // get_pressure();
        // print_battery_state();
        k_msleep(5000);
    }

    return 0;
}
```

## src/ble.c
```c
#include <ble.h>

#define BT_UUID_ONO_SERVICE_VAL     BT_UUID_128_ENCODE(0xc6ce15f6, 0x3fdf, 0x41e9, 0xb143, 0x3e806439085f)
#define BT_UUID_IMU_CHAR_VAL        BT_UUID_128_ENCODE(0x6d5e350c, 0x3115, 0x4498, 0xae46, 0xd2005911c1a1)
#define BT_UUID_CAL_CHAR_VAL        BT_UUID_128_ENCODE(0xac65b5bf, 0x3afd, 0x41ae, 0x9ecd, 0x729af13a480c)

#define BT_UUID_ONO                 BT_UUID_DECLARE_128(BT_UUID_ONO_SERVICE_VAL)
#define BT_UUID_IMU_CHAR            BT_UUID_DECLARE_128(BT_UUID_IMU_CHAR_VAL)
#define BT_UUID_CAL_CHAR            BT_UUID_DECLARE_128(BT_UUID_CAL_CHAR_VAL)

#define LOG_MODULE_NAME peripheral_imu
LOG_MODULE_REGISTER(LOG_MODULE_NAME);

bool notify_enabled = false;
struct bt_conn *current_conn = NULL;

void (*cal_cb)(bool containsData, void* buff, uint16_t len);

static struct k_work adv_work;

#define MSGQ_DEPTH      32
#define PACKET_SIZE     20

K_MEM_SLAB_DEFINE(pkt_slab, PACKET_SIZE, MSGQ_DEPTH, 4);
K_MSGQ_DEFINE(tx_q, sizeof(void*), MSGQ_DEPTH, 4);

static void notify_done(struct bt_conn *conn, void *user_data) {
    k_mem_slab_free(&pkt_slab, user_data);
}

static void clear_mem_slab() {
    void* p;

    while (k_msgq_get(&tx_q, &p, K_NO_WAIT) == 0) {
        k_mem_slab_free(&pkt_slab, p);
    }
}

static void indicate_cb(struct bt_conn *conn,
                        struct bt_gatt_indicate_params *params,
                        uint8_t err)
{
    /* Called when client acks (or times out / disconnects). */

    LOG_INF("Received indication cb, err val: %d", err);
    k_mem_slab_free(&pkt_slab, params->data);
}

static ssize_t indx_write(struct bt_conn *conn, const struct bt_gatt_attr *attr,
                          const void *buf, uint16_t len, uint16_t offset, uint8_t flags)
{
    LOG_INF("Received message from client, len %d", len);

    float* buf_f = (float*)buf;
    int8_t* buf_b = (int8_t*)buf;
    
    if (len < 4) {
        cal_cb(false, NULL, 0);
        return len;
    }

    cal_cb(true, buf, len);
    
}

static void send_sensor_packet(const void* p) {
    if (!notify_enabled) {
        k_mem_slab_free(&pkt_slab, p);
        return;
    }

    static struct bt_gatt_notify_params params;

    memset(&params, 0, sizeof(params));
    params.attr  = &ono_svc.attrs[IMU_SVC_IDX_MEAS_VAL];
    params.data  = p;
    params.len   = PACKET_SIZE;
    params.func  = notify_done;
    params.user_data = p;

    int err = bt_gatt_notify_cb(current_conn, &params);
    if (err) {
        LOG_INF("Gatt notify failed: %d", err);
        k_mem_slab_free(&pkt_slab, p);
    }
}

static void send_cal_packet(const void *p) {
    LOG_INF("Transmitting callibration packet");
    static struct bt_gatt_indicate_params ip; /* lifetime must cover the operation */
    ip.attr = &ono_svc.attrs[CAL_SVC_IDX_MEAS_VAL];;   /* required: the *value* attribute */
    ip.func = indicate_cb;       /* confirmation callback */
    ip.data = p;
    ip.len  = PACKET_SIZE;
    int err = bt_gatt_indicate(current_conn, &ip);
    if (err) {
        LOG_ERR("Gatt indicate failed: %d", err);
    }
}

static void tx_worker(void *d0, void *d1, void *d2) {
    while (1) {
        if (!current_conn) {
            k_msleep(500);
            continue;
        }

        void *p;
        k_msgq_get(&tx_q, &p, K_FOREVER);

        uint8_t *p_meta = (uint8_t*)p;
        uint8_t flags = p_meta[1];

        if (flags & BIT(0)) {
            send_cal_packet(p);
        } else {
            send_sensor_packet(p);
        }
    }
}

K_THREAD_DEFINE(bt_worker_tid, 4096, tx_worker, NULL, NULL, NULL, -5, 0, 1000);

void push_packet_to_queue(void* sensor_data) {
    if (!current_conn) return;

    LOG_DBG("num slab allocations: %d", k_mem_slab_num_used_get(&pkt_slab));

    void *p;
    int err = k_mem_slab_alloc(&pkt_slab, (void **)&p, K_NO_WAIT);
    if (err != 0) {
        LOG_INF("Message queue slab is full, clearing queue");
        clear_mem_slab();
        return;
    }

    memcpy(p, sensor_data, PACKET_SIZE);

    if (k_msgq_put(&tx_q, &p, K_NO_WAIT) != 0) {
        LOG_ERR("Message queue is full");
        k_mem_slab_free(&pkt_slab, (void *)p);
        return;
    }
}

static void ccc_cfg_changed(const struct bt_gatt_attr *attr, uint16_t value) {
    notify_enabled = (value == BT_GATT_CCC_NOTIFY);
}

BT_GATT_SERVICE_DEFINE(ono_svc,
	BT_GATT_PRIMARY_SERVICE(BT_UUID_ONO),
	BT_GATT_CHARACTERISTIC(BT_UUID_IMU_CHAR, BT_GATT_CHRC_NOTIFY,
			       BT_GATT_PERM_NONE, NULL, NULL, NULL),
	BT_GATT_CCC(ccc_cfg_changed,
		    BT_GATT_PERM_READ | BT_GATT_PERM_WRITE),

    BT_GATT_CHARACTERISTIC(BT_UUID_CAL_CHAR,
        BT_GATT_CHRC_INDICATE | BT_GATT_CHRC_WRITE | BT_GATT_CHRC_WRITE_WITHOUT_RESP,
        BT_GATT_PERM_WRITE,
        NULL, indx_write, NULL),
    BT_GATT_CCC(ccc_cfg_changed, BT_GATT_PERM_READ | BT_GATT_PERM_WRITE) // perhaps this needs its own cc callback
);

static const struct bt_data ad[] = {
    BT_DATA_BYTES(BT_DATA_FLAGS, (BT_LE_AD_GENERAL | BT_LE_AD_NO_BREDR)),
    BT_DATA_BYTES(BT_DATA_UUID128_ALL, BT_UUID_ONO_SERVICE_VAL),
};

static const struct bt_data sd[] = {
    BT_DATA(BT_DATA_NAME_COMPLETE, CONFIG_BT_DEVICE_NAME,
            sizeof(CONFIG_BT_DEVICE_NAME) - 1),
};

static void connected(struct bt_conn *conn, uint8_t err) {
    char addr[BT_ADDR_LE_STR_LEN];

    if (err) {
		LOG_ERR("Connection failed, err 0x%02x %s", err, bt_hci_err_to_str(err));
		return;
	}

    bt_addr_le_to_str(bt_conn_get_dst(conn), addr, sizeof(addr));
	LOG_INF("Connected %s", addr);

	current_conn = bt_conn_ref(conn);

    err = bt_conn_le_phy_update(current_conn, BT_CONN_LE_PHY_PARAM_2M);
    if (err) {
        LOG_ERR("Phy update request failed: %d",  err);
    }
}

static void disconnected(struct bt_conn *conn, uint8_t reason) {
    char addr[BT_ADDR_LE_STR_LEN];

	bt_addr_le_to_str(bt_conn_get_dst(conn), addr, sizeof(addr));

	LOG_INF("Disconnected: %s, reason 0x%02x %s", addr, reason, bt_hci_err_to_str(reason));

	if (current_conn) {
		bt_conn_unref(current_conn);
		current_conn = NULL;
	}
}

static void advertising_start(void) {
	k_work_submit(&adv_work);
}

static void recycled_cb(void) {
	LOG_INF("Connection object available from previous conn. Disconnect is complete!");
	advertising_start();
}

BT_CONN_CB_DEFINE(conn_callbacks) = {
	.connected        = connected,
	.disconnected     = disconnected,
	.recycled         = recycled_cb,
};

static void adv_work_handler(struct k_work *work)
{
	int err = bt_le_adv_start(BT_LE_ADV_CONN_FAST_2, ad, ARRAY_SIZE(ad), sd, ARRAY_SIZE(sd));

	if (err) {
		LOG_ERR("Advertising failed to start (err %d)", err);
		return;
	}

	LOG_INF("Advertising successfully started");
}

void ble_init(void (*cb)(bool containsData, void* buff, uint16_t len)) {
    int err = bt_enable(NULL);
    if (err) {
        LOG_ERR("bt_enable failed (%d)", err);
        return;
    }

    cal_cb = cb;

    k_work_init(&adv_work, adv_work_handler);
    advertising_start();
}
```

## src/ble.h
```c
#include <zephyr/bluetooth/bluetooth.h>
#include <zephyr/bluetooth/gatt.h>
#include <zephyr/sys/byteorder.h>
#include <zephyr/logging/log.h>
#include <zephyr/bluetooth/hci.h>

struct __packed imu_sample_v1 {
    uint8_t  ver;
    uint8_t  flags;
    uint16_t seq;
    uint32_t ts_us;
    int16_t  ax, ay, az;
    int16_t  gx, gy, gz;
};

extern bool notify_enabled;
extern struct bt_conn *current_conn;

enum {
    IMU_SVC_IDX_PRIMARY,
    IMU_SVC_IDX_MEAS_CHRC,
    IMU_SVC_IDX_MEAS_VAL,
    IMU_SVC_IDX_MEAS_CCC,
    CAL_SVC_IDX_MEAS_CHRC,
    CAL_SVC_IDX_MEAS_VAL,
    CAL_SVC_IDX_MEAS_CCC,
};

extern const struct bt_gatt_service_static ono_svc;

void ble_init();

void push_packet_to_queue(void* sensor_data);
```

## src/haptics.c
```c
#include <haptics.h>

#define HAPTICS_DEVICE DEVICE_DT_GET(DT_NODELABEL(drv_2605))
static const struct device *const vibe = HAPTICS_DEVICE;

static const uint32_t hold = 5000000;
static const uint8_t amplitude = 127;

static const struct drv2605_rtp_data config_data = {
    .size=1,
    .rtp_hold_us=&hold,
    .rtp_input=&amplitude
};

static union drv2605_config_data config = { .rtp_data = &config_data };

int haptics_init() {
    if (!device_is_ready(vibe)) {
        return -ENODEV;
    }

    int err = drv2605_haptic_config(vibe, DRV2605_HAPTICS_SOURCE_RTP, &config);

    return err;
}

int haptics_start() {
    return haptics_start_output(vibe);
}
```

## src/haptics.h
```c
#include <zephyr/kernel.h>
#include <zephyr/drivers/haptics/drv2605.h>
#include <zephyr/drivers/haptics.h>

int haptics_init();

int haptics_start();
```

## src/imu.c
```c
#include <imu.h>

#define STREAMDEV_ALIAS DT_ALIAS(imu)
#define STREAMDEV_DEVICE DEVICE_DT_GET(STREAMDEV_ALIAS)
static const struct device *const imu = STREAMDEV_DEVICE;

SENSOR_DT_STREAM_IODEV(iodev, STREAMDEV_ALIAS,
    {SENSOR_TRIG_FIFO_WATERMARK, SENSOR_STREAM_DATA_INCLUDE},
    {SENSOR_TRIG_FIFO_FULL, SENSOR_STREAM_DATA_NOP});

/* ToDo: Calculate how much memory is actually needed */
RTIO_DEFINE_WITH_MEMPOOL(stream_ctx, 4, 4, 128, 16, 4);

/* Must be power of 2 */
#define BLE_RATE 64
#define TICKS_PER_SEC 32768

void (*ble_transmit_cb)(void*);

static FusionAhrs ahrs;
static FusionOffset offset;

static uint16_t prev_timestamp = 0;

#define time_scaling 32.768/32.0

static float zVel = 0;
int counter = 0;

int write_counter = 0;

#define CAL_TIME_SEC 2
static bool callibrating = false;
float calSumX, calSumY, calSumZ;
int calCounter;

FusionMatrix accelerometerMisalignment; // = {-0.92624318, -0.35990648, -0.11198617, -0.31824553, 0.58752912, 0.74399551, -0.20197367, 0.72475986, -0.65873347};
FusionVector accelerometerSensitivity; //{1.00257195, 1.00059062, 0.99902027};
FusionVector accelerometerOffset; // {0.00194573, -0.00187991, 0.00601532};

// FusionMatrix gyroscopeMisalignment;
FusionVector gyroscopeSensitivity = {1.0f, 1.0f, 1.0f};
FusionVector gyroscopeOffset = {0.0f, 0.0f, 0.0f};

/* ToDo: Consider whether it's necessary to include all of these structs */
struct __packed icm42688_packet {
    uint8_t header;

    int16_t ac_x;
    int16_t ac_y;
    int16_t ac_z;

    int16_t gy_x;
    int16_t gy_y;
    int16_t gy_z;

    int8_t temp;

    uint16_t ts;
};

struct icm42688_decoder_header {
	uint64_t timestamp;
	uint8_t is_fifo: 1;
	uint8_t gyro_fs: 3;
	uint8_t accel_fs: 2;
	uint8_t reserved: 2;
} __attribute__((__packed__));

struct icm42688_fifo_data {
	struct icm42688_decoder_header header;
	uint8_t int_status;
	uint16_t gyro_odr: 4;
	uint16_t accel_odr: 4;
	uint16_t fifo_count: 11;
	uint16_t reserved: 5;
} __attribute__((__packed__));

void start_callibration() {
    if (callibrating) {
        printk("Callibration has already started\n");
        return;
    }

    printk("Starting callibration\n");
    calSumX = 0;
    calSumY = 0;
    calSumZ = 0;
    calCounter = 0;
    callibrating = true;
}

void feed_callibration_data(void* buff, uint16_t len) {
    int num_floats = len / sizeof(float);
    float* buff_f = (float*)buff;

    for (int i = 0; i < num_floats; i++) {
        if (write_counter < 9) {
            accelerometerMisalignment.array[write_counter/3][write_counter%3] = buff_f[i];
        } else if (write_counter < 12) {
            int idx = write_counter - 9;
            accelerometerSensitivity.array[idx] = buff_f[i];
        } else if (write_counter < 15) {
            int idx = write_counter - 12;
            accelerometerOffset.array[idx] = buff_f[i];
        }

        write_counter++;
    }

    if (write_counter == 15) {

    printk("M: \n");
        for (int i = 0; i < 3; i++) {
            printk("%.5f, %.5f, %.5f\n", accelerometerMisalignment.array[i][0], accelerometerMisalignment.array[i][1], accelerometerMisalignment.array[i][2]);
        }

        printk("S: \n");
        printk("%.5f, %.5f, %.5f\n", accelerometerSensitivity.array[0], accelerometerSensitivity.array[1], accelerometerSensitivity.array[2]);

        printk("b: \n");
        printk("%.5f, %.5f, %.5f\n", accelerometerOffset.array[0], accelerometerOffset.array[1], accelerometerOffset.array[2]);
    }
}

static void stream_data(void *p1, void *p2, void *p3) {
    // const struct device *dev = (const struct device *)p1;
    struct rtio_iodev *iodev  = (struct rtio_iodev *)p2;
    int rc = 0;
    struct rtio_cqe *cqe;
    uint8_t *buf;
    uint32_t buf_len;
    struct rtio_sqe *handle;

    q15_t pkt_temp;
    uint32_t pkt_ts;

    rc = sensor_stream(iodev, &stream_ctx, NULL, &handle);

    if (rc) {
        printk("Failed to start sensor stream %d\n", rc);
        return;
    }

    while(1) {
        while (!device_is_ready(imu)) {
            printk("ICM-42688 device not ready\n");
            k_msleep(100);
        }

        cqe = rtio_cqe_consume_block(&stream_ctx);
        rc = rtio_cqe_get_mempool_buffer(&stream_ctx, cqe, &buf, &buf_len);

        if (rc != 0) {
            printk("get mempool buffer failed %d\n", rc);
            return;
        }

        rtio_cqe_release(&stream_ctx, cqe);

        const struct icm42688_fifo_data* fifo_data = (const struct icm42688_fifo_data*) buf;
        // const struct icm42688_decoder_header *header = &fifo_data->header;
        uint8_t* buf_ptr = buf + sizeof(struct icm42688_fifo_data);
        // struct icm42688_packet* buf_pkt = (struct icm42688_packet*) buf;
        uint16_t fifo_count = fifo_data->fifo_count / sizeof(struct icm42688_packet);
        // int packet_size = sizeof(struct icm42688_packet);

        pkt_temp = buf_ptr[0xd];
        pkt_ts = buf_ptr[0xe];

        // uint8_t* byte_ptr = &(buf_pkt->temp);

        int16_t ax_buf[fifo_count], ay_buf[fifo_count], az_buf[fifo_count];
        int16_t gx_buf[fifo_count], gy_buf[fifo_count], gz_buf[fifo_count];

        // printk("Fifo count: %d\n", fifo_count);

        float xSum = 0;
        float ySum = 0;
        float zSum = 0;

        for (int i = 0; i < fifo_count; i++) {           
            uint8_t header = buf_ptr[0];
            // int16_t z = (int16_t)sys_le16_to_cpu(buf_pkt->ac_z);
            // q15_t z = (q15_t)buf_pkt->ac_z;
            ax_buf[i] = buf_ptr[0x1];
            ay_buf[i] = buf_ptr[0x3];
            // uint8_t z_accel_h = buf[0x5];
            // uint8_t z_accel_l = buf[0x6];
            // int16_t z_accel = (int16_t)sys_le16_to_cpu((z_accel_h << 8) | z_accel_l);
            // az_buf[i] = buf_ptr[0x5];

            gx_buf[i] = buf_ptr[0x7];
            gy_buf[i] = buf_ptr[0x9];
            gz_buf[i] = buf_ptr[0xb];

            q15_t x = (q15_t)((buf_ptr[0x1] << 8) | buf_ptr[0x2]);
            q15_t y = (q15_t)((buf_ptr[0x3] << 8) | buf_ptr[0x4]);
            q15_t z = (q15_t)((buf_ptr[0x5] << 8) | buf_ptr[0x6]);

            q15_t gx = (q15_t)((buf_ptr[0x7] << 8) | buf_ptr[0x8]);
            q15_t gy = (q15_t)((buf_ptr[0x9] << 8) | buf_ptr[0x10]);
            q15_t gz = (q15_t)((buf_ptr[0xb] << 8) | buf_ptr[0xc]);
            
            float axVal = ldexp((float)(x*16), -15);
            float ayVal = ldexp((float)(y*16), -15);
            float azVal = ldexp((float)(z*16), -15);

            float gxVal = ldexp((float)(gx*1000), -15);
            float gyVal = ldexp((float)(gy*1000), -15);
            float gzVal = ldexp((float)(gz*1000), -15);

            if (!callibrating) {
                uint16_t ts = ((buf_ptr[0xe] << 8) | buf_ptr[0xf]);
                uint16_t td;

                if (ts < prev_timestamp) {
                    td = ts + (UINT16_MAX - prev_timestamp);
                } else {
                    td = ts - prev_timestamp;
                }

                prev_timestamp = ts;

                float td_sec = (float)td / 1000000.0f * (float)time_scaling;

                FusionVector gyroscope = {gxVal, gyVal, gzVal};
                FusionVector accelerometer = {axVal, ayVal, azVal};

                gyroscope = FusionCalibrationInertial(gyroscope, accelerometerMisalignment, gyroscopeSensitivity, gyroscopeOffset);
                accelerometer = FusionCalibrationInertial(accelerometer, accelerometerMisalignment, accelerometerSensitivity, accelerometerOffset);

                gyroscope = FusionOffsetUpdate(&offset, gyroscope);

                FusionAhrsUpdateNoMagnetometer(&ahrs, gyroscope, accelerometer, td_sec);

                // printk("%.5f, %.5f, %.5f\n", accelerometer.axis.x, accelerometer.axis.y, accelerometer.axis.z);

                const FusionVector earth = FusionAhrsGetEarthAcceleration(&ahrs);
                // const FusionVector linear = FusionAhrsGetLinearAcceleration(&ahrs);

                // xSum += earth.axis.x;
                // ySum += earth.axis.y;
                // zSum += earth.axis.z;

                if (counter >= 100) {
                    zVel += earth.axis.z * 1000.0 * td_sec;
                } else {
                    counter++;
                }
            } 

            xSum += axVal;
            ySum += ayVal;
            zSum += azVal;

            buf_ptr += 16;
        }

        // zVel *= 0.99;

        float xMean = xSum / (float)fifo_count;
        float yMean = ySum / (float)fifo_count;
        float zMean = zSum / (float)fifo_count;

        if (callibrating) {
            calSumX += xMean;
            calSumY += yMean;
            calSumZ += zMean;
            calCounter++;

            if (calCounter == BLE_RATE * CAL_TIME_SEC) {
                struct cal_data_packet cal_data = {
                    .flags = 1,
                    .ax = calSumX / (float)calCounter,
                    .ay = calSumY / (float)calCounter,
                    .az = calSumZ / (float)calCounter,
                };

                printk("Sending callibration packet\n");
                printk("x: %.4f, y: %.4f, z: %.4f\n", cal_data.ax, cal_data.ay, cal_data.az);
                ble_transmit_cb((void*)&cal_data);
                callibrating = false;
            }
            
        } else {
            q15_t gx_mean, gy_mean, gz_mean;

            struct sensor_packet s_pkt = {
                .v = 1,
                .flags = 0,
                .time_stamp_ns = pkt_ts,
                .temp = pkt_temp,
                .aX = xMean,
                .aY = yMean,
                .aZ = zVel,
                .gX = gx_mean,
                .gY = gy_mean,
                .gZ = gz_mean,
            };

            ble_transmit_cb((void*)&s_pkt);
        }
        

        rtio_release_buffer(&stream_ctx, buf, buf_len);
    }
}

K_THREAD_DEFINE(imu_producer_tid, 4096, stream_data, (void *)imu, (void *)(&iodev), NULL, K_PRIO_COOP(5), K_INHERIT_PERMS, 0);

int imu_init(void (*transmit_cb)(struct sensor_packet*)) {
    int ret = device_is_ready(imu);
    if (!ret) {
        printk("ICM-42688 device not ready\n");
        return -1;
    }

    struct sensor_value ticks = {.val1 = TICKS_PER_SEC / BLE_RATE, .val2 = 0};
    ret = sensor_attr_set(imu, SENSOR_CHAN_ALL, SENSOR_ATTR_BATCH_DURATION, &ticks);

    if (ret) {
        printk("Unable to update FIFO size\n");
        return ret;
    }

    ble_transmit_cb = transmit_cb;

    FusionAhrsInitialise(&ahrs);
    FusionOffsetInitialise(&offset, 1024);

    const FusionAhrsSettings settings = {
            .convention = FusionConventionNwu,
            .gain = 0.6f,
            .gyroscopeRange = 1000.0f, /* replace this with actual gyroscope range in degrees/s */
            .accelerationRejection = 10.0f,
            .magneticRejection = 10.0f,
            .recoveryTriggerPeriod = 5 * 1024, /* 5 seconds */
    };
    FusionAhrsSetSettings(&ahrs, &settings);

    // k_thread_create(&thread_id, thread_stack, TASK_STACK_SIZE, stream_data, (void *)imu, (void *)(&iodev), NULL, K_PRIO_COOP(5), K_INHERIT_PERMS, K_FOREVER);
    k_thread_start(imu_producer_tid);


    return 0;
}

int imu_start_streaming() {
    

    return 0;
}
```

## src/imu.h
```c
#include <zephyr/kernel.h>
// #include <zephyr/arch/arm64/arch.h>
#include <zephyr/kernel/thread_stack.h>
#include <zephyr/drivers/sensor.h>
#include <zephyr/rtio/rtio.h>
#include <math.h>
#include "Fusion.h"

#include <zephyr/sys/byteorder.h>

struct __packed sensor_packet {
    uint8_t v;
    uint8_t flags;
    uint32_t time_stamp_ns;
    int16_t temp;
    int16_t aX, aY, aZ;
    int16_t gX, gY, gZ;
};

struct __packed cal_data_packet {
    uint8_t v;
    uint8_t flags;
    float ax, ay, az;
    uint8_t filler[6];
};

int imu_init(void (*transmit_cb)(struct sensor_packet*));
void start_callibration();
void feed_callibration_data(void* buff, uint16_t len);
int imu_start_streaming();
```

## src/pmic.c
```c
#include <pmic.h>

#define ZEPHYR_USER_NODE DT_PATH(zephyr_user)
static const struct gpio_dt_spec wc_en_0 = GPIO_DT_SPEC_GET(ZEPHYR_USER_NODE, en0_gpios);
static const struct gpio_dt_spec wc_en_1 = GPIO_DT_SPEC_GET(ZEPHYR_USER_NODE, en1_gpios);

#define PMIC_DEVICE DEVICE_DT_GET(DT_NODELABEL(npm1300_pmic))
#define CHARGER_DEVICE DEVICE_DT_GET(DT_NODELABEL(npm1300_charger))
#define V_TERM_US DT_PROP(DT_NODELABEL(npm1300_charger), term_microvolt) 

static const struct device *const pmic = PMIC_DEVICE;
static const struct device *const charger = CHARGER_DEVICE;

static struct gpio_callback pmic_cb;

extern struct k_timer en_wc_timer;
static const int PROBE_INT_S = 10;

static int getBatteryMv() {
    /* Must run sensor_sample_fetch before calling this function */
    struct sensor_value battery_voltage;
    sensor_channel_get(charger, SENSOR_CHAN_GAUGE_VOLTAGE, &battery_voltage);
    double volts = sensor_value_to_double(&battery_voltage);

    return (int)(volts*1000);
}

static void enable_wireless_charging(bool enable) {
    printk("Wireless charging enabled: %d\n", enable);

    gpio_pin_set_dt(&wc_en_0, enable);
    gpio_pin_set_dt(&wc_en_1, enable);
}

static void check_en_wc(struct k_work *work) {
    printk("Checking voltage\n");

    sensor_sample_fetch(charger);
    int mv = getBatteryMv();
    int v_term_ms = V_TERM_US / 1000;

    if (mv < v_term_ms * 0.98) {
        enable_wireless_charging(true);
        k_timer_stop(&en_wc_timer);
    }
}

K_WORK_DEFINE(en_wc_work, check_en_wc);

static void wc_timer_handler(struct k_timer *timer) {
    k_work_submit(&en_wc_work);
}

K_TIMER_DEFINE(en_wc_timer, wc_timer_handler, NULL);

static void pmic_evt_cb(const struct device *dev, struct gpio_callback *cb, uint32_t events) {
    if (events & BIT(NPM1300_EVENT_CHG_COMPLETED)) {
        printk("Charge completed\n");
        enable_wireless_charging(false);
        k_timer_start(&en_wc_timer, K_SECONDS(PROBE_INT_S), K_SECONDS(PROBE_INT_S));
    }
}

void print_battery_state() {
    if (!device_is_ready(charger)) {
        printk("Charger device is not ready\n");
        return;
    }

    sensor_sample_fetch(charger);
    
    struct sensor_value i;

    sensor_channel_get(charger, SENSOR_CHAN_GAUGE_AVG_CURRENT, &i);

    double amps = sensor_value_to_double(&i);
    int mv = getBatteryMv();

    printk("Pulling %d mA from battery; Battery voltage: %d mV\n\n", (int)(amps * 1000), mv);         
}

int pmic_init() {
    if (!device_is_ready(pmic)) { 
        return -ENODEV;
    }

    uint32_t mask = BIT(NPM1300_EVENT_CHG_COMPLETED);

    gpio_init_callback(&pmic_cb, pmic_evt_cb, mask);

    int err = mfd_npm1300_add_callback(pmic, &pmic_cb);

    if (err) {
        printk("add_callback failed: %d\n", err);
        return err;
    }

    gpio_pin_configure_dt(&wc_en_0, GPIO_OUTPUT_ACTIVE);
    gpio_pin_configure_dt(&wc_en_1, GPIO_OUTPUT_ACTIVE);

    return 0;
}
```

## src/pmic.h
```c
#include <zephyr/kernel.h>
#include <zephyr/drivers/sensor.h>
#include <zephyr/drivers/mfd/npm1300.h>
#include <zephyr/drivers/sensor/npm1300_charger.h>
#include <zephyr/drivers/gpio.h>

void print_battery_state();

int pmic_init();
```

## src/pressure.c
```c
#include <pressure.h>

#define PRESSURE_DEVICE DEVICE_DT_GET(DT_NODELABEL(lps28dfw))
static const struct device *const pres = PRESSURE_DEVICE;

float get_pressure() {
    sensor_sample_fetch(pres);

    struct sensor_value pressure_val;
    sensor_channel_get(pres, SENSOR_CHAN_PRESS, &pressure_val);
    float pressure = sensor_value_to_double(&pressure_val);
    printk("Pressure: %d\n", (int)(pressure*1000));
}

int pressure_init() {
    k_msleep(2000);
    bool rdy = device_is_ready(pres);
    printk("Barometer ready: %d\n", rdy);

    return rdy;
}
```

## src/pressure.h
```c
#include <zephyr/kernel.h>
#include <zephyr/device.h>
#include <zephyr/drivers/sensor.h>

int pressure_init();

float get_pressure();
```
